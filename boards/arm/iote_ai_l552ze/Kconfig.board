## boards/arm/iote_ai_l552ze/Kconfig.board
```kconfig
# IOTE.AI L552ZE board configuration

# Copyright (c) 2021 Petri Oksanen
# SPDX-License-Identifier: Apache-2.0

config BOARD_IOTE_AI_L552ZE
	bool "IOTE.AI L552ZE Development Board"
	depends on SOC_STM32L552XX
```

## boards/arm/iote_ai_l552ze/Kconfig.defconfig
```kconfig
# IOTE.AI L552ZE board configuration

# Copyright (c) 2021 Petri Oksanen
# SPDX-License-Identifier: Apache-2.0

if BOARD_IOTE_AI_L552ZE

config BOARD
	default "iote_ai_l552ze"


endif # BOARD_IOTE_AI_L552ZE
```
